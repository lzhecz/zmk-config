#include "dac360.dtsi"

&default_transform { // The matrix transform for this board is 7 columns over because the left half is 7 columns wide according to the matrix.
    row-offset = <6>;
};

&kscan0 {
    col-gpios
                = <&pro_micro 4 GPIO_ACTIVE_HIGH>
                , <&pro_micro 5 GPIO_ACTIVE_HIGH>
                , <&pro_micro 6 GPIO_ACTIVE_HIGH>
                , <&pro_micro 7 GPIO_ACTIVE_HIGH>
                , <&pro_micro 8 GPIO_ACTIVE_HIGH>
                , <&pro_micro 9 GPIO_ACTIVE_HIGH>
                ;
};
