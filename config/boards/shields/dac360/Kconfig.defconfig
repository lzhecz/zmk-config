## config/boards/shields/dac360/Kconfig.defconfig
```kconfig
if SHIELD_DAC360LEFT

config ZMK_KEYBOARD_NAME
    default "Dac360"

config ZMK_SPLIT_ROLE_CENTRAL
    default y

endif

if SHIELD_DAC360LEFT || SHIELD_DAC360RIGHT

config ZMK_SPLIT
    default y

endif
```

## config/boards/shields/dac360/Kconfig.shield
```kconfig
config SHIELD_DAC360LEFT
    def_bool $(shields_list_contains,dac360left)

config SHIELD_DAC360RIGHT
    def_bool $(shields_list_contains,dac360right)
```
